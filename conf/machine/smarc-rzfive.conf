## conf/machine/smarc-rzfive.conf
```bitbake
#@TYPE: Machine
#@NAME: smarc-rzfive
#@SOC: Renesas RZ/Five (R9A07G043F)
#@DESCRIPTION: Machine configuration for Renesas RZ/Five SMARC EVK

require conf/machine/include/riscv/tune-riscv.inc

MACHINE_FEATURES = "screen keyboard ext2 ext3 serial"

KERNEL_CLASSES = "kernel-fitimage"
KERNEL_IMAGETYPE = "fitImage"
KERNEL_ALT_IMAGETYPE = "Image"
KERNEL_DEVICETREE ?= "renesas/r9a07g043f01-smarc.dtb"

PREFERRED_PROVIDER_virtual/kernel ?= "linux-smarc-rzfive"
PREFERRED_PROVIDER_virtual/bootloader ?= "u-boot-smarc-rzfive"

EXTRA_IMAGEDEPENDS += "opensbi"
RISCV_SBI_PLAT = "generic"
RISCV_SBI_FDT ?= "r9a07g043f01-smarc.dtb"

SERIAL_CONSOLES = "115200;ttySC0"

MACHINE_EXTRA_RRECOMMENDS += " kernel-modules"

IMAGE_FSTYPES ?= "wic.gz ext4 tar.bz2"

EXTRA_IMAGEDEPENDS += "u-boot-smarc-rzfive"
UBOOT_MACHINE = "smarc-rzf_defconfig"

## wic default support
WKS_FILE_DEPENDS ?= " \
    u-boot-smarc-rzfive \
    opensbi \
    e2fsprogs-native \
    bmap-tools-native \
"

IMAGE_BOOT_FILES ?= " \
    Image-smarc-rzfive.bin \
    ${RISCV_SBI_FDT} \
"

EXTRA_IMAGEDEPENDS += " flash-writer"

WKS_FILE ?= "smarc-rzfive.wks"
```

## wic/smarc-rzfive.wks
```
# short-description: Create SD card image for RZ/Five (AX45MP Single)

part /boot --source bootimg-partition --ondisk mmcblk0 --fstype=vfat --label boot --active --fixed-size 64M --align 4096
part / --source rootfs --ondisk mmcblk0 --fstype=ext4 --label root --align 4096 --size 64M
```
